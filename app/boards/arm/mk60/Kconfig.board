## app/boards/arm/mk60/Kconfig.board
```kconfig
# Copyright (c) 2021 Miguelio
# SPDX-License-Identifier: MIT

config BOARD_MK60
	bool "mk60"
	depends on SOC_NRF52833_QIAA
```

## app/boards/arm/mk60/mk60_defconfig
```kconfig
# Copyright (c) 2021 Miguelio
# SPDX-License-Identifier: MIT

CONFIG_SOC_SERIES_NRF52X=y
CONFIG_SOC_NRF52833_QIAA=y
CONFIG_BOARD_MK60=y

# Enable MPU
CONFIG_ARM_MPU=y

# enable GPIO
CONFIG_GPIO=y

CONFIG_USE_DT_CODE_PARTITION=y

CONFIG_MPU_ALLOW_FLASH_WRITE=y
CONFIG_NVS=y
CONFIG_SETTINGS_NVS=y
CONFIG_FLASH=y
CONFIG_FLASH_PAGE_LAYOUT=y
CONFIG_FLASH_MAP=y

# clock configuration
# CONFIG_CLOCK_CONTROL_NRF=y
# CONFIG_CLOCK_CONTROL_NRF_K32SRC_RC=y

# ----------------------------------

CONFIG_BT_MAX_CONN=1
CONFIG_ZMK_SLEEP=y

# RGB underglow
CONFIG_ZMK_RGB_UNDERGLOW=y
CONFIG_WS2812_STRIP=y
CONFIG_ZMK_RGB_UNDERGLOW_ON_START=y
CONFIG_ZMK_RGB_UNDERGLOW_EFF_START=3

# Uncomment to enable led indicador
CONFIG_ZMK_USB_REPORT_LEDS=y
CONFIG_ZMK_RGB_INDICATOR=y

# Uncomment to enable encoder
CONFIG_EC11=y
CONFIG_EC11_TRIGGER_GLOBAL_THREAD=y

# Uncomment to enable logging
CONFIG_ZMK_USB_LOGGING=n

# Debounce custom times
CONFIG_ZMK_KSCAN_DEBOUNCE_PRESS_MS=0
CONFIG_ZMK_KSCAN_DEBOUNCE_RELEASE_MS=10
```
